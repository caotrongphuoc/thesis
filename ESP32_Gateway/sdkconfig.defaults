## ESP32_Gateway/sdkconfig.defaults
```kconfig
CONFIG_BT_ENABLED=y
CONFIG_BT_BLE_ENABLED=y
CONFIG_BT_BLUEDROID_ENABLED=y
CONFIG_BTDM_CTRL_MODE_BLE_ONLY=y
CONFIG_BT_BLE_MESH_NODE=y
CONFIG_BT_BLE_MESH_PROV=y
CONFIG_BT_BLE_MESH_PROXY=y
CONFIG_BT_BLE_MESH_RELAY=y
CONFIG_BT_BLE_MESH_PB_ADV=y
CONFIG_BT_BLE_MESH_PB_GATT=y
CONFIG_BT_BLE_MESH_PROVISIONER=y
CONFIG_BT_BLE_MESH_SENSOR_CLI=y
CONFIG_BT_BLE_MESH_CFG_CLI=y
CONFIG_BT_BLE_MESH_NET_BUF_POOL_SIZE=40
CONFIG_BT_BLE_MESH_MSG_CACHE_SIZE=20
CONFIG_BT_BLE_MESH_ADV_BUF_COUNT=60
CONFIG_BT_BLE_MESH_CRPL=40
CONFIG_BT_BLE_MESH_FRIEND=n
CONFIG_BT_BLE_MESH_LOW_POWER=n
CONFIG_PARTITION_TABLE_SINGLE_APP=y
CONFIG_ESPTOOLPY_FLASHSIZE_4MB=y
```
